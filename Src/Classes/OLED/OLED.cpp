/*
 * OLED.cpp
 *
 *  Created on: Jan 13, 2019
 *      Author: Marek
 */

#include <OLED.h>
#include <i2c.h>

const uint8_t logo_knr [] = {
		0x00, 0x00, 0x00, 0x00, 0x00, 0x00, 0x00, 0x00, 0x00, 0x00, 0x00, 0x00,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 0x00,
		0x00, 0x00, 0x00, 0x00, 0x00, 0x00, 0x00, 0x00, 0x00, 0x00, 0x00, 0x00,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 0x00,
		0x00, 0x00, 0x00, 0x00, 0x00, 0x00, 0x00, 0x00, 0x00, 0x00, 0x00, 0x00,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 0x00,
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		0x00, 0x00, 0x00, 0x00, 0x00, 0x00, 0x00, 0x00, 0x00, 0x00, 0x00, 0x00,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 0x00,
};

OLED oled;

int counter;

void OLED::Init(void){
	MX_I2C2_Init();

	osDelay(200);
	counter = 0;

	OLED_reset();
	OLED_Init_Registers();
	//reset_buffer();
	setImage(1);
	update_all_screen();

}

void OLED::update_all_screen(){
	for(int i = 0; i < OLED_BUFFER_SIZE; i++) {
		send_DATA(buffer[i]);
	}
}

void OLED::setImage(unsigned int imageId){
	//uint8_t* imageArrayHandler;

	switch(imageId){
	case 1:
		//imageArrayHandler = this->logo_knr;
		break;
	}

	for(int i = 0; i < OLED_BUFFER_SIZE; i++) {
		//buffer[i] = imageArrayHandler[i];
		buffer[i] = logo_knr[i];
		//osDelay(5);
	}
}

void OLED::send_REG(uint8_t cmd){
	uint8_t W_Buf[2] ;
	W_Buf[0] = 0x00;
	W_Buf[1] = cmd;
	HAL_I2C_Master_Transmit(&hi2c2, (0X3D << 1) | 0X00, W_Buf, 2, 0x10);
	//osDelay(5);
}


void OLED::send_DATA(uint8_t data){
	uint8_t W_Buf[3] ;
	W_Buf[0] = 0x40;
	W_Buf[1] = data;
	HAL_I2C_Master_Transmit(&hi2c2, (0X3D << 1) | 0X00, W_Buf, 2, 0x10);
	osDelay(1);
}

void OLED::OLED_Init_Registers(){
	send_REG(0xae);
	send_REG(0x15);
	send_REG(0x00);
	send_REG(0x7f);
	send_REG(0x75);
	send_REG(0x00);
	send_REG(0x7f);
	send_REG(0x81);
	send_REG(0x80);
	send_REG(0xa0);
	send_REG(0x51);
	send_REG(0xa1);
	send_REG(0x00);
	send_REG(0xa2);
	send_REG(0x00);
	send_REG(0xa4);
	send_REG(0xa8);
	send_REG(0x7f);
	send_REG(0xb1);
	send_REG(0xf1);
	send_REG(0xb3);
	send_REG(0x70); //80Hz:0xc1 90Hz:0xe1   100Hz:0x00   110Hz:0x30 120Hz:0x50   130Hz:0x70
	send_REG(0xab);
	send_REG(0x01);
	send_REG(0xb6);
	send_REG(0x0f);

	send_REG(0xbe);
	send_REG(0x0f);

	send_REG(0xbc);
	send_REG(0x08);

	send_REG(0xd5);
	send_REG(0x62);

	send_REG(0xfd);
	send_REG(0x12);

	send_REG(0xAF);
}

void OLED::process(){
	counter++;
	counter = counter % 2;
	if(counter) reset_buffer();
	else setImage(1);
	update_all_screen();
	osDelay(5);
}

void OLED::reset_buffer(){
	for(unsigned int i = 0; i < OLED_BUFFER_SIZE; i++) buffer[i] = 0;
}

void OLED::OLED_reset(){
	//for(int i = 0; i < 8192; i++) send_DATA(0);
}


OLED::OLED() {
	// TODO Auto-generated constructor stub

}

OLED::~OLED() {
	// TODO Auto-generated destructor stub
}
